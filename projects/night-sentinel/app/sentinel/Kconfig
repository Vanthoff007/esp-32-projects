## projects/night-sentinel/app/sentinel/Kconfig
```kconfig
menu "Night Sentinel app"

    config NS_PERSON_LABEL
        string "Model label that counts as a person"
        default "person"
        help
            The app works with any model in models/ that has a label with this name.

    config NS_HEARTBEAT_S
        int "Heartbeat every N seconds (0 = off)"
        default 60
        help
            One line with uptime, fps, free memory, Wi-Fi signal, events and state, on serial
            (H,...) and in /sdcard/heartbeat.csv. Used by the soak test.

    config NS_DEMO_MODE
        bool "Demo mode: 15 s cooldown instead of 30 s"
        default n

endmenu
```

## projects/night-sentinel/components/alerts/Kconfig
```kconfig
menu "Night Sentinel alerts"

    config NS_AUDIO_ENABLED
        bool "Speak the warning on the speaker"
        default y
        help
            Turn off to test at night without waking the house. Detection, push and SD
            evidence still work.

    config NS_AUDIO_GAIN_PCT
        int "Speaker volume, percent of the recorded level"
        range 0 400
        default 100
        help
            Above 100 the clip gets louder but its peaks start to clip. Lower it if the board
            resets during playback (brown-out from IR LEDs + Wi-Fi + speaker together).

endmenu
```

## projects/night-sentinel/components/net/Kconfig
```kconfig
menu "Night Sentinel network"

    config NS_WIFI_SSID
        string "Wi-Fi SSID (optional fallback)"
        default ""
        help
            Network to try when nothing has been saved from the setup page yet.
            Leave empty to always start in setup mode on first boot.
            The board can't see 5 GHz networks.

    config NS_WIFI_PASSWORD
        string "Wi-Fi password (optional fallback)"
        default ""
        help
            Stored in sdkconfig, which is git-ignored, so it never reaches GitHub.

    config NS_PORTAL_SSID
        string "Setup hotspot name"
        default "NightSentinel-Setup"
        help
            Hotspot the board opens when it can't join a network. Join it from a phone and
            open http://192.168.4.1/ to pick a nearby network and type its password.

    config NS_PORTAL_PASSWORD
        string "Setup hotspot password"
        default "sentinel123"
        help
            8+ characters for WPA2. Shorter (or empty) makes the hotspot open, so anyone
            nearby could see the home password you type into the page.

    config NS_NTFY_SERVER
        string "ntfy server"
        default "https://ntfy.sh"
        help
            Phone push service. Install the ntfy app and subscribe to the topic below.

    config NS_NTFY_TOPIC
        string "ntfy topic (keep it secret)"
        default ""
        help
            Anyone who knows the topic can read the alerts and photos, so use 20+ random
            characters, e.g. ns-7f3kq9w2... It lives in sdkconfig, which is git-ignored.
            Empty = no phone push (events are still spoken and saved to SD).

    config NS_TZ
        string "Time zone (POSIX TZ string)"
        default "IST-5:30"
        help
            Used for event file names and timestamps. India: IST-5:30.
            Central Europe: CET-1CEST,M3.5.0,M10.5.0/3.

endmenu
```

## projects/night-sentinel/main/Kconfig.projbuild
```kconfig
menu "Night Sentinel build"

    config NS_DEBUG_HTTP
        bool "Web server (page, live view, /snap.jpg, /detect, /sd, actions)"
        default y
        help
            Development tool with no password. Turn off for a demo build.
            The other switches are with their components:
              Platform: inference    which model is built in, start at boot or not
              Platform: recorder     video recording
              Platform: web server   live stream
              Platform: camera and IR
              Night Sentinel app / network / alerts

endmenu
```

## projects/night-sentinel/models/pedestrian_pico/Kconfig
```kconfig
# 1. Add this model to the "Model" list (menuconfig -> Platform: inference).
choice NS_MODEL # ignore: multiple-definition
    config NS_MODEL_PEDESTRIAN_PICO
        bool "pedestrian_pico: person detector, ESP-DL, 224x224 int8 (~125 ms)"
endchoice

# 2. Its own settings, only shown while it is the chosen model.
menu "Model: pedestrian_pico"
    depends on NS_MODEL_PEDESTRIAN_PICO

    config NS_PEDESTRIAN_PICO_SCORE_PCT
        int "Score threshold, percent"
        range 1 99
        default 70
        help
            Boxes below this score are dropped by the model. 70 is the model's own default.
            An app can change it at runtime with ns_infer_set_param("score_thr", ...):
            Night Sentinel sets 0.30 so near misses reach the log.

    config NS_PEDESTRIAN_PICO_NMS_PCT
        int "NMS threshold, percent"
        range 1 99
        default 50
        help
            Two boxes that overlap by more than this are treated as the same person, and
            only the better one is kept.

endmenu
```

## projects/night-sentinel/platform/camera/Kconfig
```kconfig
menu "Platform: camera and IR"

    choice NS_IR_MODE
        prompt "IR LEDs at boot"
        default NS_IR_AUTO
        config NS_IR_AUTO
            bool "automatic, from the light sensor (with hysteresis)"
        config NS_IR_ALWAYS_ON
            bool "always on"
        config NS_IR_ALWAYS_OFF
            bool "always off (control tests)"
    endchoice

    config NS_IR_ON_BELOW_LUX
        int "Automatic IR: turn on below this many lux"
        default 3
        help
            The LTR-308 read 0.1 lux in the dark test room and ~35-85 lux with room light.
            The IR LEDs themselves barely change the reading, so they can't fool the switch.

    config NS_IR_OFF_ABOVE_LUX
        int "Automatic IR: turn off above this many lux"
        default 10
        help
            Must be well above the "on" level, so the IR doesn't flicker on and off at dusk.

    config NS_JPEG_QUALITY
        int "JPEG quality for snapshots, live stream and recordings (1-100)"
        range 10 100
        default 80

endmenu
```

## projects/night-sentinel/platform/debug_http/Kconfig
```kconfig
menu "Platform: web server"

    config NS_STREAM_ENABLED
        bool "Live video stream (port 81)"
        default y
        help
            Off = the stream server is not started at all (saves a task and its memory).
            With it on, the stream can still be switched off at runtime from the web page.

endmenu
```

## projects/night-sentinel/platform/infer/Kconfig
```kconfig
menu "Platform: inference"

    # Each folder in models/ adds its own entry to this list (see models/README.md).
    choice NS_MODEL # ignore: multiple-definition
        prompt "Model"
        help
            The one model that is built into the firmware. Its weights file is read from the
            SD card at start-up (see "Folder with model weight files").

        config NS_MODEL_NONE
            bool "none (inference compiled out)"
    endchoice

    config NS_MODEL_DIR
        string "Folder with model weight files"
        default "/sdcard/models"
        help
            Where the model's weights file is looked for. Copy files there with
            tools/sd.py push <file> models/  (or put the card in a PC).

    config NS_INFER_AT_BOOT
        bool "Start inference at boot"
        default y
        help
            Off = wait for the Start button on the web page (or /action?name=detect&arg=1).

    config NS_FRAME_CSV
        bool "Print one CSV line per frame on serial (F,t_ms,n,score,x1,y1,x2,y2,...)"
        default y
        help
            Input for tools/serial_log.py, host_test replay and tools/sweep.py.
            Turn off for a demo build.

endmenu
```

## projects/night-sentinel/platform/recorder/Kconfig
```kconfig
menu "Platform: recorder"

    config NS_REC_ENABLED
        bool "Video recording to the SD card"
        default y
        help
            Off = the recorder is compiled out. With it on, recording still only happens in
            the mode chosen below or on the web page.

    if NS_REC_ENABLED

    choice NS_REC_BOOT_MODE
        prompt "Recording at boot"
        default NS_REC_BOOT_OFF
        help
            The mode after every reboot. It can be changed from the web page until the next
            reboot.
        config NS_REC_BOOT_OFF
            bool "off"
        config NS_REC_BOOT_CONTINUOUS
            bool "continuous"
        config NS_REC_BOOT_EVENT
            bool "event clips"
    endchoice

    config NS_REC_FPS
        int "Recorded frames per second (at most)"
        range 1 15
        default 5
        help
            A 320x240 frame is ~9 KB, so 5 fps is ~45 KB/s: about 160 MB per hour.

    config NS_REC_SEGMENT_S
        int "Continuous mode: seconds per file"
        range 10 600
        default 60
        help
            A power cut loses at most the file being written.

    config NS_REC_PREROLL_S
        int "Event clips: seconds kept from before the trigger"
        range 0 5
        default 3

    config NS_REC_CLIP_S
        int "Event clips: seconds recorded after the trigger"
        range 2 60
        default 10

    config NS_REC_MIN_FREE_MB
        int "Keep at least this many MB free on the card"
        range 10 4096
        default 100
        help
            Before a new file is started, the oldest recordings are deleted until this much
            is free. Only files in /sdcard/rec are deleted.

    endif

endmenu
```
